## drivers/misc/mediatek/accelerometer/bma2xx-new/Kconfig
```kconfig
config MTK_BMA2XX_ACC_NEW
	bool "BMA253_new_acc for MediaTek package"
	default n
```

## drivers/misc/mediatek/hq_hwinfo/Kconfig
```kconfig
config HQ_HWINFO
	bool "HQ Hardware Infomation"
	default n
	help
	  HQ HardWare Infomation
```

## drivers/misc/mediatek/imgsensor/Kconfig
```kconfig
config MTK_IMGSENSOR
  bool CONFIG_MTK_IMGSENSOR
  default n
  help
    CONFIG_MTK_IMGSENSOR

config MTK_EFUSE_DOWNGRADE
  bool "CONFIG_MTK_EFUSE_DOWNGRADE"
  default n
  help
    CONFIG_MTK_EFUSE_DOWNGRADE

config MAYA_L22
  bool "CONFIG_MAYA_L22"
  default n
  help
    CONFIG_MAYA_L22
```

## drivers/misc/mediatek/magnetometer/afx133/Kconfig
```kconfig
config MTK_AFX133_NEW
	bool "AFX133 for MediaTek package"
	default n
	help
	  It support different magnetometer sensor.
          If this option is set,
	  it will support
          AFX133 magnetometer.
```

## drivers/misc/mediatek/nfc_nxp/Kconfig
```kconfig
menuconfig NXP_NFC
	tristate "NFC drivers"
	default n
	---help---
	  Say Y here for supporting NFC.
	  Say Y here for supporting NFC.
	  Say Y here for supporting NFC.

if NXP_NFC


config NFC_PN548
	tristate "PN548 NFC driver"
	default n
	help
	  Y means NFC_PN548 wil use. If you are not sure about this, set n.

endif 
```
